## config/Kconfig
```kconfig
mainmenu "Blackhole Configuration Menu"
    menu "*Blackhole Base"
        choice
            prompt "Base Compiler"
            default BASE_COMP_CXX
            config BASE_COMP_CXX
                bool "g++"
        endchoice
        config BASE_COMP
            string
            default "g++" if BASE_COMP_CXX
            default "none"
        choice
            prompt "Base Compiler Optimization Level"
            default BASE_COMP_O2
            config BASE_COMP_OPT0
                bool "O0"
            config BASE_COMP_OPT1
                bool "O1"
            config BASE_COMP_OPT2
                bool "O2"
            config BASE_COMP_OPT3
                bool "O3"
        endchoice
        config BASE_COMP_OPT
            string
            default "-O0" if BASE_COMP_OPT0
            default "-O1" if BASE_COMP_OPT1
            default "-O2" if BASE_COMP_OPT2
            default "-O3" if BASE_COMP_OPT3
            default "none"
        config BASE_COMP_DEBUG
            bool "Base Compiler Debug"
            default n
        config BASE_COMP_ASAN
            bool "Base Compiler Address Sanitizer"
            default n
        choice
            prompt "Base CPU ISA"
            default BASE_CPU_ISA_RISCV32
            config BASE_CPU_ISA_RISCV32
                bool "riscv32"
            config BASE_CPU_ISA_RISCV64
                bool "riscv64"
        endchoice
            config BASE_CPU_ISA
                string
                default "riscv32" if BASE_CPU_ISA_RISCV32
                default "riscv64" if BASE_CPU_ISA_RISCV64
                default "none"
            config BASE_CPU_ISA32
                depends on BASE_CPU_ISA_RISCV32
                bool
                default y
            config BASE_CPU_ISA64
                depends on BASE_CPU_ISA_RISCV64
                bool
                default y
    endmenu

    menu "*Blackhole Debug"
        config DEBUG_LOG
            bool "Debug Log"
            default y
        config DEBUG_LOG_STDOUT
            depends on DEBUG_LOG
            bool "Output Log to STDOUT"
            default y
        config DEBUG_LOG_FILE
            depends on DEBUG_LOG
            bool "Output Log to FILE"
            default y
        config DEBUG_LDB
            bool "Debug LDB"
            default n
        config DEBUG_TRACE
            bool "Debug Trace"
            default y
        config DEBUG_TRACE_INS
            depends on DEBUG_TRACE
            bool "Trace for instruction"
            default y
        config DEBUG_TRACE_INS_PROCESS
            depends on DEBUG_TRACE_INS
            bool "Trace instruction when the condition is process"
            default y
        config DEBUG_TRACE_INS_RESULT
            depends on DEBUG_TRACE_INS
            bool "Trace instruction when the condition is result"
            default n
        config DEBUG_TRACE_MEM
            depends on DEBUG_TRACE
            bool "Trace for memory"
            default n
        config DEBUG_TRACE_MEM_PROCESS
            depends on DEBUG_TRACE_MEM
            bool "Trace memory when the condition is process"
            default y
        config DEBUG_TRACE_MEM_RESULT
            depends on DEBUG_TRACE_MEM
            bool "Trace memory when the condition is result"
            default n
        config DEBUG_TRACE_FCT
            depends on DEBUG_TRACE
            bool "Trace for function"
            default n
        config DEBUG_TRACE_FCT_PROCESS
            depends on DEBUG_TRACE_FCT
            bool "Trace function when the condition is process"
            default y
        config DEBUG_TRACE_FCT_RESULT
            depends on DEBUG_TRACE_FCT
            bool "Trace function when the condition is result"
            default n
        config DEBUG_TRACE_DEV
            depends on DEBUG_TRACE
            bool "Trace for device"
            default n
        config DEBUG_TRACE_DEV_PROCESS
            depends on DEBUG_TRACE_DEV
            bool "Trace device when the condition is process"
            default y
        config DEBUG_TRACE_DEV_RESULT
            depends on DEBUG_TRACE_DEV
            bool "Trace device when the condition is result"
            default n
        config DEBUG_TRACE_ECT
            depends on DEBUG_TRACE
            bool "Trace for exception"
            default n
        config DEBUG_TRACE_ECT_PROCESS
            depends on DEBUG_TRACE_ECT
            bool "Trace exception when the condition is process"
            default y
        config DEBUG_TRACE_ECT_RESULT
            depends on DEBUG_TRACE_ECT
            bool "Trace exception when the condition is result"
            default n
        config DEBUG_DIFF
            bool "Debug Diff"
            default n
        config DEBUG_WAVE
            bool "Debug Wave"
            default n
        config DEBUG_WAVE_CYCLE
            depends on DEBUG_WAVE
            int "Wave cycles"
            default 10000
    endmenu

    menu "-Blackhole Memory"
        config MEMORY_BASE
            hex "Memory Base Address"
            default 0x80000000
        config MEMORY_SIZE
            hex "Memory Size"
            default 0x08000000
    endmenu

    menuconfig DEVICE
        bool "-Blackhole Device"
        default n
        if DEVICE
            menuconfig DEVICE_SERIAL
                bool "Device Serial"
                default y
                if DEVICE_SERIAL
                    config DEVICE_SERIAL_MMIO
                        hex "Serial address"
                        default 0xa00003f8
                endif

            menuconfig DEVICE_TIMER
                bool "Device Timer"
                default y
                if DEVICE_TIMER
                    config DEVICE_TIMER_MMIO
                        hex "Timer address"
                        default 0xa0000048
                endif

            menuconfig DEVICE_KEYBOARD
                bool "Device Keyboard"
                default y
                if DEVICE_KEYBOARD
                    config DEVICE_KEYBOARD_MMIO
                        hex "Keyboard address"
                        default 0xa0000060
                endif

            menuconfig DEVICE_VGA
                bool "Device VGA"
                default y
                if DEVICE_VGA
                    config DEVICE_VGA_FB_ADDR
                        hex "VGA framebuffer address"
                        default 0xa1000000
                    config DEVICE_VGA_CTL_MMIO
                        hex "VGA controller address "
                        default 0xa0000100
                    choice
                        prompt "VGA screen size"
                        default DEVICE_VGA_SIZE_400x300
                    config DEVICE_VGA_SIZE_400x300
                        bool "400 x 300"
                    config DEVICE_VGA_SIZE_800x600
                        bool "800 x 600"
                    endchoice
                endif

            menuconfig DEVICE_AUDIO
                bool "Device Audio"
                default y
                if DEVICE_AUDIO
                    config DEVICE_AUDIO_SB_ADDR
                        hex "Audio streambuffer address"
                        default 0xa1200000
                    config DEVICE_AUDIO_SB_SIZE
                        hex "Audio streambuffer size"
                        default 0x00010000
                    config DEVICE_AUDIO_CTL_MMIO
                        hex "Audio controller address"
                        default 0xa0000200
                endif
        endif
```

## core/config/device/Kconfig
```kconfig
menuconfig DEVICE
    depends on !TARGET_SHARE
    bool "-Meteor Devices"
    default n
    help
        Provide device support for Meteor.

    if DEVICE
        config HAS_PORT_IO
            bool
            default y if ISA_x86
            default n

        menuconfig HAS_SERIAL
            bool "Enable Serial"
            default y
            if HAS_SERIAL
                config SERIAL_PORT
                    depends on HAS_PORT_IO
                    hex "Port address of the serial controller"
                    default 0x3f8
                config SERIAL_MMIO
                    hex "MMIO address of the serial controller"
                    default 0xa00003f8
                config SERIAL_INPUT_FIFO
                bool "Enable input FIFO with /tmp/meteor.serial"
                default n
            endif

        menuconfig HAS_TIMER
            bool "Enable Timer"
            default y
            if HAS_TIMER
                config TIMER_PORT
                    depends on HAS_PORT_IO
                    hex "Port address of the timer"
                    default 0x48
            config TIMER_MMIO
                hex "MMIO address of the timer"
                default 0xa0000048
            endif

        menuconfig HAS_KEYBOARD
            bool "Enable Keyboard"
            default y
            if HAS_KEYBOARD
                config KEYBOARD_PORT
                    depends on HAS_PORT_IO
                    hex "Port address of the keyboard controller"
                    default 0x60
                config KEYBOARD_MMIO
                    hex "MMIO address of the keyboard controller"
                    default 0xa0000060
            endif

        menuconfig HAS_VGA
        bool "Enable VGA"
        default y
        if HAS_VGA
            config VGA_FB_ADDR
                hex "Physical address of the VGA frame buffer"
                default 0xa1000000
            config VGA_CTL_PORT
                depends on HAS_PORT_IO
                hex "Port address of the VGA controller"
                default 0x100
            config VGA_CTL_MMIO
                hex "MMIO address of the VGA controller"
                default 0xa0000100
            config VGA_SHOW_SCREEN
                bool "Enable SDL SCREEN"
                default y
            choice
                prompt "Screen Size"
                default VGA_SIZE_400x300
            config VGA_SIZE_400x300
                bool "400 x 300"
            config VGA_SIZE_800x600
                bool "800 x 600"
            endchoice
        endif

        if !TARGET_AM
            menuconfig HAS_AUDIO
                bool "Enable Audio"
                default y
                if HAS_AUDIO
                    config AUDIO_SB_ADDR
                        hex "Physical address of the audio stream buffer"
                        default 0xa1200000
                    config AUDIO_SB_SIZE
                        hex "Size of the audio stream buffer"
                        default 0x10000
                    config AUDIO_CTL_PORT
                        depends on HAS_PORT_IO
                        hex "Port address of the audio controller"
                        default 0x200
                    config AUDIO_CTL_MMIO
                        hex "MMIO address of the audio controller"
                        default 0xa0000200
                endif

            menuconfig HAS_DISK
                bool "Enable Disk"
                default y
                if HAS_DISK
                    config DISK_CTL_PORT
                        depends on HAS_PORT_IO
                        hex "Port address of the disk controller"
                        default 0x300
                    config DISK_CTL_MMIO
                        hex "MMIO address of the disk controller"
                        default 0xa0000300
                    config DISK_IMG_PATH
                        string "The path of disk image"
                        default ""
                endif

            menuconfig HAS_SDCARD
            bool "Enable SD Card"
            default n
            if HAS_SDCARD
                config SDCARD_CTL_MMIO
                    hex "MMIO address of the sdcard controller"
                    default 0xa3000000
                config SDCARD_IMG_PATH
                    string "The path of sdcard image"
                    default ""
            endif
        endif
    endif
```
